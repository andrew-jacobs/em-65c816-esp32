;===============================================================================
;  _____ __  __        __  ____   ____ ___  _  __
; | ____|  \/  |      / /_| ___| / ___( _ )/ |/ /_
; |  _| | |\/| |_____| '_ \___ \| |   / _ \| | '_ \
; | |___| |  | |_____| (_) |__) | |__| (_) | | (_) |
; |_____|_|__|_|___ __\___/____/ \____\___/|_|\___/
; | ____/ ___||  _ \___ /___ \
; |  _| \___ \| |_) ||_ \ __) |
; | |___ ___) |  __/___) / __/
; |_____|____/|_|  |____/_____|
;
;-------------------------------------------------------------------------------
; Copyright (C)2018-2019 Andrew John Jacobs
; All rights reserved.
;
; This work is made available under the terms of the Creative Commons
; Attribution-NonCommercial-ShareAlike 4.0 International license. Open the
; following URL to see the details.
;
; http://creativecommons.org/licenses/by-nc-sa/4.0/
;===============================================================================
;
; Notes:
;
;-------------------------------------------------------------------------------
		
;===============================================================================
; WDM Signature Bytes
;-------------------------------------------------------------------------------

WDM_IER_RD	.equ	$00
WDM_IER_WR	.equ	$01
WDM_IER_SET	.equ	$02
WDM_IER_CLR	.equ	$03

WDM_IFR_RD	.equ	$04
WDM_IFR_WR	.equ	$05
WDM_IFR_SET	.equ	$06
WDM_IFR_CLR	.equ	$07

WDM_U1TX	.equ	$08
WDM_U1RX	.equ	$09

;===============================================================================
; IER/IFR Bits
;-------------------------------------------------------------------------------

INT_CLK		.equ	$0001
INT_U1RX	.equ	$0002
INT_U1TX	.equ	$0004
